/*
 * Weather Station - ESP32 Code
 * Generated by RobotStudio Workflow Wizard
 *
 * Hardware:
 * - ESP32 DevKit
 * - DHT22 Temperature/Humidity Sensor (Pin 4)
 * - BMP280 Pressure Sensor (I2C)
 * - LDR Light Sensor (Pin 34)
 *
 * Serial Output Format:
 * TEMP:25.5
 * HUMIDITY:60.2
 * PRESSURE:1013.25
 * LIGHT:450
 */

#include <Wire.h>
#include <DHT.h>
#include <Adafruit_BMP280.h>

// Pin definitions
#define DHT_PIN 4
#define DHT_TYPE DHT22
#define LIGHT_SENSOR_PIN 34

// Sensor objects
DHT dht(DHT_PIN, DHT_TYPE);
Adafruit_BMP280 bmp;

// Timing
unsigned long lastReadTime = 0;
const unsigned long READ_INTERVAL = 1000; // Read every 1 second

void setup() {
  // Initialize serial communication
  Serial.begin(115200);
  delay(1000);

  Serial.println("Weather Station Initializing...");

  // Initialize DHT22
  dht.begin();
  Serial.println("DHT22 initialized");

  // Initialize BMP280
  if (!bmp.begin(0x76)) { // Try address 0x76, if fails try 0x77
    if (!bmp.begin(0x77)) {
      Serial.println("ERROR: Could not find BMP280 sensor!");
      Serial.println("Check wiring and I2C address");
    }
  }

  if (bmp.begin(0x76) || bmp.begin(0x77)) {
    bmp.setSampling(Adafruit_BMP280::MODE_NORMAL,
                    Adafruit_BMP280::SAMPLING_X2,
                    Adafruit_BMP280::SAMPLING_X16,
                    Adafruit_BMP280::FILTER_X16,
                    Adafruit_BMP280::STANDBY_MS_500);
    Serial.println("BMP280 initialized");
  }

  // Configure light sensor pin
  pinMode(LIGHT_SENSOR_PIN, INPUT);
  Serial.println("Light sensor initialized");

  Serial.println("Weather Station Ready!");
  Serial.println("Sending data every 1 second...");
  Serial.println("---");
}

void loop() {
  unsigned long currentTime = millis();

  // Read sensors at specified interval
  if (currentTime - lastReadTime >= READ_INTERVAL) {
    lastReadTime = currentTime;

    // Read DHT22 (temperature and humidity)
    float temperature = dht.readTemperature();
    float humidity = dht.readHumidity();

    // Read BMP280 (pressure)
    float pressure = bmp.readPressure() / 100.0F; // Convert Pa to hPa

    // Read light sensor (0-4095 on ESP32 ADC)
    int lightRaw = analogRead(LIGHT_SENSOR_PIN);
    float lightPercent = (lightRaw / 4095.0) * 100.0;

    // Check for DHT22 errors
    if (isnan(temperature) || isnan(humidity)) {
      Serial.println("ERROR: Failed to read from DHT22 sensor!");
      temperature = -999;
      humidity = -999;
    }

    // Send data in RobotStudio-compatible format
    Serial.print("TEMP:");
    Serial.println(temperature, 2);

    Serial.print("HUMIDITY:");
    Serial.println(humidity, 2);

    Serial.print("PRESSURE:");
    Serial.println(pressure, 2);

    Serial.print("LIGHT:");
    Serial.println(lightPercent, 2);

    Serial.println("---"); // Data separator
  }

  delay(10); // Small delay to prevent overwhelming serial
}
