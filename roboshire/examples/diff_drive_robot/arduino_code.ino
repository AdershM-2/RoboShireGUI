/*
 * Differential Drive Robot - Arduino Mega Code
 * Generated by RobotStudio Workflow Wizard
 *
 * Hardware:
 * - Arduino Mega 2560
 * - L298N Motor Driver (Pins 5, 6, 7, 8, 9, 10)
 * - MPU6050 IMU (I2C: SDA=20, SCL=21)
 * - HC-SR04 Ultrasonic Sensor (Trig=12, Echo=13)
 * - 2x DC Motors (left and right)
 *
 * Serial Protocol:
 * INPUT (from ROS2):
 *   MOTOR:left_speed,right_speed  (e.g., MOTOR:150,-150)
 *
 * OUTPUT (to ROS2):
 *   IMU:ax,ay,az,gx,gy,gz
 *   DISTANCE:cm
 */

#include <Wire.h>
#include <MPU6050.h>

// Motor driver pins (L298N)
#define MOTOR_LEFT_PWM 5
#define MOTOR_LEFT_IN1 6
#define MOTOR_LEFT_IN2 7
#define MOTOR_RIGHT_PWM 10
#define MOTOR_RIGHT_IN1 8
#define MOTOR_RIGHT_IN2 9

// Ultrasonic sensor pins
#define TRIG_PIN 12
#define ECHO_PIN 13

// IMU object
MPU6050 mpu;

// Timing
unsigned long lastSensorRead = 0;
const unsigned long SENSOR_INTERVAL = 50; // Read sensors every 50ms (20Hz)

// Serial buffer
String serialBuffer = "";

void setup() {
  // Initialize serial
  Serial.begin(115200);
  delay(1000);

  Serial.println("Differential Drive Robot Initializing...");

  // Initialize motor pins
  pinMode(MOTOR_LEFT_PWM, OUTPUT);
  pinMode(MOTOR_LEFT_IN1, OUTPUT);
  pinMode(MOTOR_LEFT_IN2, OUTPUT);
  pinMode(MOTOR_RIGHT_PWM, OUTPUT);
  pinMode(MOTOR_RIGHT_IN1, OUTPUT);
  pinMode(MOTOR_RIGHT_IN2, OUTPUT);

  // Stop motors initially
  stopMotors();
  Serial.println("Motors initialized");

  // Initialize ultrasonic sensor
  pinMode(TRIG_PIN, OUTPUT);
  pinMode(ECHO_PIN, INPUT);
  Serial.println("Ultrasonic sensor initialized");

  // Initialize I2C for IMU
  Wire.begin();

  // Initialize MPU6050
  mpu.initialize();
  if (mpu.testConnection()) {
    Serial.println("MPU6050 initialized successfully");
  } else {
    Serial.println("ERROR: MPU6050 connection failed!");
  }

  Serial.println("Robot Ready!");
  Serial.println("Waiting for commands...");
  Serial.println("---");
}

void loop() {
  unsigned long currentTime = millis();

  // Read and send sensor data
  if (currentTime - lastSensorRead >= SENSOR_INTERVAL) {
    lastSensorRead = currentTime;

    // Read IMU
    readIMU();

    // Read ultrasonic sensor
    readUltrasonic();
  }

  // Process incoming serial commands
  processSerialCommands();

  delay(5);
}

void readIMU() {
  int16_t ax, ay, az, gx, gy, gz;
  mpu.getMotion6(&ax, &ay, &az, &gx, &gy, &gz);

  // Convert to g and deg/s
  float ax_g = ax / 16384.0;
  float ay_g = ay / 16384.0;
  float az_g = az / 16384.0;
  float gx_dps = gx / 131.0;
  float gy_dps = gy / 131.0;
  float gz_dps = gz / 131.0;

  // Send IMU data
  Serial.print("IMU:");
  Serial.print(ax_g, 3); Serial.print(",");
  Serial.print(ay_g, 3); Serial.print(",");
  Serial.print(az_g, 3); Serial.print(",");
  Serial.print(gx_dps, 2); Serial.print(",");
  Serial.print(gy_dps, 2); Serial.print(",");
  Serial.println(gz_dps, 2);
}

void readUltrasonic() {
  // Trigger ultrasonic pulse
  digitalWrite(TRIG_PIN, LOW);
  delayMicroseconds(2);
  digitalWrite(TRIG_PIN, HIGH);
  delayMicroseconds(10);
  digitalWrite(TRIG_PIN, LOW);

  // Read echo pulse
  long duration = pulseIn(ECHO_PIN, HIGH, 30000); // 30ms timeout

  // Calculate distance in cm
  float distance = duration * 0.034 / 2.0;

  // Check for timeout or invalid reading
  if (duration == 0 || distance > 400) {
    distance = -1; // Indicate no object detected
  }

  // Send distance data
  Serial.print("DISTANCE:");
  Serial.println(distance, 1);
}

void processSerialCommands() {
  while (Serial.available() > 0) {
    char c = Serial.read();

    if (c == '\n') {
      // Process complete command
      processCommand(serialBuffer);
      serialBuffer = "";
    } else {
      serialBuffer += c;
    }
  }
}

void processCommand(String cmd) {
  cmd.trim();

  if (cmd.startsWith("MOTOR:")) {
    // Parse motor command: MOTOR:left_speed,right_speed
    String speeds = cmd.substring(6);
    int commaIndex = speeds.indexOf(',');

    if (commaIndex > 0) {
      int leftSpeed = speeds.substring(0, commaIndex).toInt();
      int rightSpeed = speeds.substring(commaIndex + 1).toInt();

      setMotors(leftSpeed, rightSpeed);

      Serial.print("ACK:MOTOR:");
      Serial.print(leftSpeed);
      Serial.print(",");
      Serial.println(rightSpeed);
    }
  }
  else if (cmd == "STOP") {
    stopMotors();
    Serial.println("ACK:STOP");
  }
}

void setMotors(int leftSpeed, int rightSpeed) {
  // Constrain speeds
  leftSpeed = constrain(leftSpeed, -255, 255);
  rightSpeed = constrain(rightSpeed, -255, 255);

  // Left motor
  if (leftSpeed >= 0) {
    digitalWrite(MOTOR_LEFT_IN1, HIGH);
    digitalWrite(MOTOR_LEFT_IN2, LOW);
    analogWrite(MOTOR_LEFT_PWM, leftSpeed);
  } else {
    digitalWrite(MOTOR_LEFT_IN1, LOW);
    digitalWrite(MOTOR_LEFT_IN2, HIGH);
    analogWrite(MOTOR_LEFT_PWM, -leftSpeed);
  }

  // Right motor
  if (rightSpeed >= 0) {
    digitalWrite(MOTOR_RIGHT_IN1, HIGH);
    digitalWrite(MOTOR_RIGHT_IN2, LOW);
    analogWrite(MOTOR_RIGHT_PWM, rightSpeed);
  } else {
    digitalWrite(MOTOR_RIGHT_IN1, LOW);
    digitalWrite(MOTOR_RIGHT_IN2, HIGH);
    analogWrite(MOTOR_RIGHT_PWM, -rightSpeed);
  }
}

void stopMotors() {
  digitalWrite(MOTOR_LEFT_IN1, LOW);
  digitalWrite(MOTOR_LEFT_IN2, LOW);
  analogWrite(MOTOR_LEFT_PWM, 0);

  digitalWrite(MOTOR_RIGHT_IN1, LOW);
  digitalWrite(MOTOR_RIGHT_IN2, LOW);
  analogWrite(MOTOR_RIGHT_PWM, 0);
}
